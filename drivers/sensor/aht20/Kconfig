## drivers/sensor/aht20/Kconfig
```kconfig
# Copyright (c) 2016 Intel Corporation
# SPDX-License-Identifier: Apache-2.0

config AHT20
	bool "AHT20 Temperature and Humidity Sensor"
	depends on I2C
	help
	  Enable driver for the AHT20 temperature and humidity sensor.
```
